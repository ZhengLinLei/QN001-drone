## src/QN001-CAM/sdkconfig.defaults
```kconfig
CONFIG_BOOTLOADER_LOG_LEVEL_NONE=y
CONFIG_LOG_DEFAULT_LEVEL_NONE=y
CONFIG_SPIRAM=y

# Habilitar PSRAM
CONFIG_ESP32_SPIRAM_SUPPORT=y
CONFIG_ESP32_SPIRAM=y
CONFIG_ESP32_SPIRAM_TYPE_AUTO=y
CONFIG_ESP32_SPIRAM_SIZE=-1
CONFIG_ESP32_SPIRAM_SPEED_80M=y
CONFIG_ESP32_SPIRAM_MEMTEST=y
CONFIG_ESP32_SPIRAM_CACHE_WORKAROUND=y
CONFIG_SPIRAM_CACHE_WORKAROUND_STRATEGY_MEMW=y
CONFIG_SPIRAM_USE_CAPS_ALLOC=y
CONFIG_SPIRAM_USE_MALLOC=y
CONFIG_SPIRAM_MALLOC_ALWAYSINTERNAL=16384
CONFIG_SPIRAM_MALLOC_RESERVE_INTERNAL=32768
CONFIG_SPIRAM_ALLOW_STACK_EXTERNAL_MEMORY=y
CONFIG_SPIRAM_ALLOW_BSS_SEG_EXTERNAL_MEMORY=y

# Frecuencias de Flash y PSRAM a 80MHz
CONFIG_ESPTOOLPY_FLASHFREQ_80M=y
CONFIG_ESPTOOLPY_FLASHSIZE_4MB=y
CONFIG_ESPTOOLPY_FLASHMODE_QIO=y
CONFIG_SPI_FLASH_MODE=0x0
CONFIG_SPI_FLASH_SIZE=0x400000
CONFIG_SPI_FLASH_FREQ=0x0
```
